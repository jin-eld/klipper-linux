## targets/cubietruck/conf/local.conf
```bitbake
DISTRO = "klipper-linux"
MACHINE = "cubietruck"

PRSERV_HOST = "localhost:0"

PACKAGE_CLASSES = " package_ipk "

INHERIT += "rm_work"

TOPDIR = "${YOCTO_TOPDIR}/${DISTRO}-build"
TMPDIR = "${TOPDIR}/build"

IMAGE_FEATURES += "debug-tweaks"

IMAGE_BOOT_FILES = "boot.scr sun7i-a20-cubietruck.dtb uImage"
```

## targets/tinker-board-s/conf/bblayers.conf
```bitbake
LCONF_VERSION = "7"
  
BBLAYERS = " \
    ${YOCTO_TOPDIR}/yocto/poky/meta \
    ${YOCTO_TOPDIR}/yocto/poky/meta-poky \
    ${YOCTO_TOPDIR}/yocto/poky/meta-yocto-bsp \
    ${YOCTO_TOPDIR}/yocto/meta-openembedded/meta-oe \
    ${YOCTO_TOPDIR}/yocto/meta-openembedded/meta-python \
    ${YOCTO_TOPDIR}/yocto/meta-openembedded/meta-perl \
    ${YOCTO_TOPDIR}/yocto/meta-openembedded/meta-networking \
    ${YOCTO_TOPDIR}/yocto/meta-arm/meta-arm-toolchain \
    ${YOCTO_TOPDIR}/yocto/meta-arm/meta-arm \
    ${YOCTO_TOPDIR}/yocto/meta-rockchip \
    ${YOCTO_TOPDIR}/yocto/meta-python2 \
    ${YOCTO_TOPDIR}/yocto/meta-klipper \
"

BBMASK = "${YOCTO_TOPDIR}/yocto/meta-klipper/recipes-kernel/linux/linux-mainline_%.bbappend"
```

## targets/tinker-board-s/conf/local.conf
```bitbake
DISTRO = "klipper-linux"
MACHINE = "tinker-board-s"

#BBMULTICONFIG = "avr"

PRSERV_HOST = "localhost:0"

PACKAGE_CLASSES = " package_ipk "

INHERIT += "rm_work"

TOPDIR = "${YOCTO_TOPDIR}/${DISTRO}-build"
TMPDIR = "${TOPDIR}/build"

IMAGE_FEATURES += "debug-tweaks"
```

## yocto/meta-klipper/conf/distro/klipper-linux.conf
```bitbake
# This distro is based on Poky
require conf/distro/poky.conf

DISTRO = "klipper-linux"
DISTRO_NAME = "Klipper 3D Linux Distribution"
MAINTAINER = "Sergey 'Jin' Bostandzhyan <jin@mediatomb.cc>"

PACKAGE_CLASSES = "package_ipk"

GLIBC_GENERATE_LOCALES ?= "en_US.UTF-8"
IMAGE_LINGUAS ?= "en-us"

DISTRO_FEATURES = "ext2 ipv4 ipv6 usbgadget usbhost sysvinit dconfig zeroconf"

# octoprint depends on some particular versions
PREFERRED_VERSION_python-websocket-client = "0.56.0"
PREFERRED_VERSION_python-pkginfo = "1.5.0.1"
PREFERRED_VERSION_python-jinja2 = "2.8.1"
PREFERRED_VERSION_python-flask = "0.12.5"
PREFERRED_VERSION_python-pytest = "4.6.6"
PREFERRED_VERSION_python-tornado = "4.5.3"
```

## yocto/meta-klipper/conf/layer.conf
```bitbake
# prepend to BBPATH so that our classes have higher prio
BBPATH =. "${LAYERDIR}:"

BBFILES += "${LAYERDIR}/recipes*/*/*.bb ${LAYERDIR}/recipes*/*/*.bbappend"

BBFILE_COLLECTIONS += "meta-klipper"
BBFILE_PATTERN_meta-klipper := "^${LAYERDIR}/"
BBFILE_PRIORITY_meta-klipper = "10"

LAYERDEPENDS_meta-klipper = "core openembedded-layer meta-python"

LAYERSERIES_COMPAT_meta-klipper = "dunfell"
```
